## boards/shields/keyball61/Kconfig.defconfig
```kconfig
if SHIELD_KEYBALL61_LEFT

# Name must be less than 16 characters long!
config ZMK_KEYBOARD_NAME
    default "Keyball 61"

config ZMK_SPLIT_ROLE_CENTRAL
    default y

endif

if SHIELD_KEYBALL61_LEFT || SHIELD_KEYBALL61_RIGHT

config ZMK_SPLIT
    default y

endif
```

## config/west.yml
```yaml
manifest:
  remotes:
    - name: zmkfirmware
      url-base: https://github.com/zmkfirmware
    - name: bullwinkle3000
      url-base: https://github.com/bullwinkle3000
    - name: badjeff
      url-base: https://github.com/badjeff
    - name: george-norton
      url-base: https://github.com/george-norton
  projects:
    - name: zmk
      remote: zmkfirmware
      revision: main
      import: app/west.yml
    - name: zmk-input-processor-xyz
      remote: badjeff
      revision: main
    - name: zmk-driver-pmw3360
      remote: george-norton
      revision: main
  self:
    path: config
```
