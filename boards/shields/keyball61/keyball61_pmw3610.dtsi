#include <zephyr/dt-bindings/input/input-event-codes.h>

&pro_micro_spi {
    status = "okay";
    compatible = "nordic,nrf-spim";
    miso-pin = <14>; // P0.17
    mosi-pin = <16>; // P0.20
    sck-pin = <15>; // P0.22
    cs-gpios = <&gpio0 10 GPIO_ACTIVE_LOW>;

    trackball: trackball@0 {
        status = "okay";
        compatible = "pixart,pmw3360";
        reg = <0>;
        spi-max-frequency = <2000000>;
        irq-gpios = <&gpio0 9 (GPIO_ACTIVE_LOW | GPIO_PULL_UP)>;
    };
};

/{
    trackball_listener {
        compatible = "zmk,input-listener";
        device = <&trackball>;
    };
};